## hnet/Config.in
```kconfig
#
# Author: Pierre Pfister <pierre.pfister at darou.fr>
#
# Copyright (c) 2013 Cisco Systems, Inc.
#
# This is free software, licensed under the GNU General Public License v2.
#

	menu "hnet custom configuration"
		depends on PACKAGE_hnet

		config PACKAGE_hnet-setup-network
			bool "Use specific network configuration file (when available)"
			default n
			help
			  Default OpenWRT network configuration is mostly switched. 
			  On some platforms, hnet provides a routing-oriented network 
			  configuration file. This option will install it automaticaly.

		config PACKAGE_hnet-setup-hostname
			bool "Set a custom hostname"
			default n
			help
			  This option allows you to modify the hostname 
			  after installation.

		config PACKAGE_hnet-hostname
			depends on PACKAGE_hnet-setup-hostname
			string "Choose hostname"
			default "inner"
			help
			  This must be set to the new hostname.
			  This field must comply to the rules specified in 
			  RFC1034.

		config PACKAGE_hnet-dhcpv4-clientid
			string "Optional dhcpv4 client ID in base 16"
			default ""
			help
			  This is used to set a custom dhcpv4 client ID. It must be a valid
			  client ID, written in base 16.

		config PACKAGE_hnet-dhcpv6-clientid
			string "Optional dhcpv6 client ID in base 16"
			default ""
			help
			  This is used to set a custom dhcpv6 client ID. It must be a valid
			  client ID, written in base 16.

	endmenu
```
